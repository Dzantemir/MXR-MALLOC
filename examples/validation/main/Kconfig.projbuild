## examples/validation/main/Kconfig.projbuild
```kconfig
menu "MxR validation (development board only)"
config MXR_TEST_CACHE_OFF
    bool "Run destructive cache-off smoke test"
    default n
    depends on MXR_IRAM_PATH_ALLOC_FAMILY && MXR_CANARY && MXR_DOUBLE_FREE_DETECT
    help
        Runs after init with SDK critical section and NMI masked.
        Intentionally corrupts a canary and repeats a free to exercise
        deferred error reporting. Use a disposable development board.
        Not suitable for production or an active Wi-Fi connection.
endmenu
```

## examples/validation/sdkconfig.defaults
```kconfig
CONFIG_MXR_INTEGRATION_WRAP=y
CONFIG_MXR_USE_IRAM=y
CONFIG_MXR_IRAM_FALLBACK_ENABLED=y
CONFIG_MXR_DESC_IN_IRAM_BSS=y
CONFIG_MXR_STATE_IN_IRAM=y
CONFIG_MXR_IRAM_PATH_ALLOC_FAMILY=y
CONFIG_MXR_CANARY=y
CONFIG_MXR_DOUBLE_FREE_DETECT=y
CONFIG_MXR_DUMP_MINIMAL=y
CONFIG_MXR_DEFAULT_DRAM_ONLY=y
CONFIG_MXR_MAX_DESC=256
CONFIG_MXR_IRAM_MAX_DESC=128
```

## mxr_heap/Kconfig.projbuild
```kconfig
menu "MxR-malloc"

# ============================================================
#  Preset selection
# ============================================================
choice
    prompt "Allocation preset"
    default MXR_PRESET_CUSTOM
    help
        Select a memory layout preset tuned for a typical workload,
        or Custom to configure regions manually.

    config MXR_PRESET_CUSTOM
        bool "Custom - manual configuration"
    config MXR_PRESET_BALANCED
        bool "Balanced - general purpose (3 regions)"
    config MXR_PRESET_MINIMAL
        bool "Minimal - bare-metal, no WiFi (2 regions)"
    config MXR_PRESET_WIFI_STATION
        bool "WiFi Station - LWIP client (3 regions)"
    config MXR_PRESET_WIFI_AP
        bool "WiFi AP - many clients (4 regions)"
    config MXR_PRESET_TLS
        bool "TLS / HTTPS - mbedtls (4 regions)"
    config MXR_PRESET_AUDIO
        bool "Audio / Streaming - ADPCM, I2S, TCP (4 regions)"
    config MXR_PRESET_HTTP_SERVER
        bool "HTTP Server - esp_http_server (4 regions)"
    config MXR_PRESET_SENSOR
        bool "Sensor / Low-power (3 regions)"
    config MXR_PRESET_LOGGING
        bool "Logging / Debug - heavy ESP_LOG (3 regions)"
endchoice

# ============================================================
#  Global settings
# ============================================================
config MXR_MAX_DESC
    int "Maximum simultaneous allocations"
    range 16 4096
    default 256
    help
        Maximum number of active allocation descriptors.
        Shared between DRAM and IRAM.
        Each descriptor is 8 bytes, stored in IRAM (.iram0.bss).
        256 descriptors = 2048 bytes IRAM.
        1024 descriptors = 8192 bytes IRAM.

choice
    prompt "Descriptor table placement"
    default MXR_DESC_IN_DRAM
    help
        Select where the allocation descriptor table is stored.

        DRAM (.bss):
            Default. Safest. Table in regular DRAM BSS.
            No linker modifications needed.
            Cost: sizeof(table) bytes of DRAM.

        IRAM (.iram0.text):
            Table placed in IRAM code section.
            Works WITHOUT linker script modifications.
            Table is loaded from flash at boot (PROGBITS).
            Cost: sizeof(table) bytes in binary + IRAM.

        IRAM (.iram0.bss):
            Table placed in IRAM BSS section.
            REQUIRES patched linker script:
              add *(.iram0.bss .iram0.bss.*) to .iram0.bss section
              in esp8266.project.ld.in
            Table is NOT loaded from flash (NOLOAD).
            Cost: sizeof(table) bytes of IRAM only.

    config MXR_DESC_IN_DRAM
        bool "DRAM (.bss) - default, safest"

    config MXR_DESC_IN_IRAM_TEXT
        bool "IRAM (.iram0.text) - no linker patch needed"

    config MXR_DESC_IN_IRAM_BSS
        bool "IRAM (.iram0.bss) - requires patched linker script"
endchoice

config MXR_COMPACT_TYPES
    bool "Compact types (uint16 where possible, for ESP8266)"
    default y
    help
        ESP8266: arena <= 128 KB, size classes <= 64 KB,
        alloc count <= 4096. uint16 is enough for
        caps / min / max / alloc_count in region structs.

        Disable for ESP32 or if you need size classes > 64 KB.

config MXR_IRAM_HOT_PATH_DISABLED
    bool "Disable placing malloc/free hot path in IRAM"
    default n

choice
    prompt "IRAM hot path scope"
    depends on !MXR_IRAM_HOT_PATH_DISABLED
    default MXR_IRAM_PATH_CORE
    config MXR_IRAM_PATH_CORE
        bool "Core (malloc/free only)"
    config MXR_IRAM_PATH_ALLOC_FAMILY
        bool "Allocation family (malloc/free/calloc/zalloc/realloc)"
endchoice

# ============================================================
#  IRAM heap
# ============================================================
config MXR_USE_IRAM
    bool "Enable IRAM heap (EXEC + 32BIT fallback)"
    default y if !CONFIG_HEAP_DISABLE_IRAM
    default n
    help
        Enable IRAM heap region.
        MALLOC_CAP_EXEC allocations go to IRAM.
        Ordinary 32BIT allocations use DRAM first.
        If DRAM cannot allocate, IRAM is used as fallback.
        DMA and 8BIT allocations never go to IRAM.

config MXR_IRAM_RESERVE_BYTES
    int "Reserve IRAM bytes for EXEC allocations"
    depends on MXR_USE_IRAM
    range 0 32768
    default 2048

config MXR_IRAM_FALLBACK_MAX_BYTES
    int "Maximum block size for IRAM fallback"
    depends on MXR_USE_IRAM
    range 0 65536
    default 0

# ============================================================
#  Region configuration (preset-driven)
# ============================================================
config MXR_REGIONS
    int "Number of heap regions" if MXR_PRESET_CUSTOM
    range 1 16
    default 3  if MXR_PRESET_CUSTOM
    default 3  if MXR_PRESET_BALANCED
    default 2  if MXR_PRESET_MINIMAL
    default 3  if MXR_PRESET_WIFI_STATION
    default 4  if MXR_PRESET_WIFI_AP
    default 4  if MXR_PRESET_TLS
    default 4  if MXR_PRESET_AUDIO
    default 4  if MXR_PRESET_HTTP_SERVER
    default 3  if MXR_PRESET_SENSOR
    default 3  if MXR_PRESET_LOGGING

config MXR_REGION_SIZES
    string "Lower block size boundaries for regions, bytes" if MXR_PRESET_CUSTOM
    depends on MXR_REGIONS > 1
    default "4,132,1024"      if MXR_PRESET_CUSTOM
    default "4,132,1024"      if MXR_PRESET_BALANCED
    default "4,256"           if MXR_PRESET_MINIMAL
    default "4,132,1500"      if MXR_PRESET_WIFI_STATION
    default "4,96,512,1500"   if MXR_PRESET_WIFI_AP
    default "4,132,1024,4096" if MXR_PRESET_TLS
    default "4,256,1024,4096" if MXR_PRESET_AUDIO
    default "4,132,512,2048"  if MXR_PRESET_HTTP_SERVER
    default "4,64,256"        if MXR_PRESET_SENSOR
    default "4,96,512"        if MXR_PRESET_LOGGING
    help
        Comma-separated lower block size boundaries in bytes.
        Count must equal MXR_REGIONS.
        Values are aligned to 4 bytes internally.

config MXR_REGION_PERCENTS
    string "Memory weights for regions" if MXR_PRESET_CUSTOM
    depends on MXR_REGIONS > 1
    default "15,45,20"    if MXR_PRESET_CUSTOM
    default "15,45,0"     if MXR_PRESET_BALANCED
    default "30,0"        if MXR_PRESET_MINIMAL
    default "15,45,0"     if MXR_PRESET_WIFI_STATION
    default "12,25,30,0"  if MXR_PRESET_WIFI_AP
    default "10,20,25,0"  if MXR_PRESET_TLS
    default "10,25,25,0"  if MXR_PRESET_AUDIO
    default "12,25,30,0"  if MXR_PRESET_HTTP_SERVER
    default "20,30,0"     if MXR_PRESET_SENSOR
    default "25,40,0"     if MXR_PRESET_LOGGING

# ============================================================
#  Cross-region DRAM fallback
# ============================================================
config MXR_CROSS_REGION_FALLBACK
    bool "Enable cross-region DRAM fallback (last resort)"
    depends on MXR_REGIONS > 1
    default n

config MXR_CROSS_REGION_CHECK_LARGEST
    bool "Check largest free block before cross-region fallback"
    depends on MXR_CROSS_REGION_FALLBACK
    default n

# ============================================================
#  Linker integration
# ============================================================
menu "Linker integration"

config MXR_WRAP_HEAP_QUERY
    bool "Wrap heap_caps_get_free_size / minimum / dram"
    default y

config MXR_WRAP_DEFAULT_POOL
    bool "Wrap heap_caps_malloc_default / realloc_default"
    default y

config MXR_WRAP_ESP_SYSTEM
    bool "Wrap esp_get_free_heap_size / minimum / internal"
    default y

config MXR_WRAP_LIBC
    bool "Wrap plain malloc / free / calloc / realloc / zalloc"
    default n

config MXR_WARN_HEAP_TRACING
    bool "Warn if CONFIG_HEAP_TRACING is enabled"
    default y

endmenu

# ============================================================
#  Diagnostics
# ============================================================
choice
    prompt "Diagnostics output level"
    default MXR_DUMP_NORMAL
    config MXR_DUMP_MINIMAL
        bool "Minimal - totals only"
    config MXR_DUMP_NORMAL
        bool "Normal - totals, regions and counters"
    config MXR_DUMP_FULL
        bool "Full - normal plus all descriptors"
endchoice
        
endmenu
```
